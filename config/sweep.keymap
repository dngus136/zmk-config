// Boot into macOS; SYS + physical W switches between macOS and Windows.
// Both profiles preserve the 34-key layout and the five-layer structure.
#define MAC_OS
#include "keypos_def/keypos_34keys.h"
#include "includes/sweep-dual-os.dtsi"
